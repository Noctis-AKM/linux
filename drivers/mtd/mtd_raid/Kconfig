## drivers/mtd/mtd_raid/Kconfig
```kconfig
menuconfig MTD_RAID
	tristate "MTD RAID Support"
	depends on MTD
	help
	  This is a module for MTD raid. There are two ways to use
	  it. One for multi-chips flash drivers, driver can call
	  mtd_raid_create() to create raid device in requested level.
	  The other for user, user can use problem of mtd_raid to
	  create raid device from flashes they have in system.

	  More about raid:
	  <https://en.wikipedia.org/wiki/Standard_RAID_levels>.
```

## fs/ubifs/Kconfig
```kconfig
config UBIFS_FS
	tristate "UBIFS file system support"
	select CRC16
	select CRC32
	select CRYPTO if UBIFS_FS_ADVANCED_COMPR
	select CRYPTO if UBIFS_FS_LZO
	select CRYPTO if UBIFS_FS_ZLIB
	select CRYPTO_LZO if UBIFS_FS_LZO
	select CRYPTO_DEFLATE if UBIFS_FS_ZLIB
	depends on MTD_UBI
	help
	  UBIFS is a file system for flash devices which works on top of UBI.

config UBIFS_FS_ADVANCED_COMPR
	bool "Advanced compression options"
	depends on UBIFS_FS
	help
	  This option allows to explicitly choose which compressions, if any,
	  are enabled in UBIFS. Removing compressors means inability to read
	  existing file systems.

	  If unsure, say 'N'.

config UBIFS_FS_LZO
	bool "LZO compression support" if UBIFS_FS_ADVANCED_COMPR
	depends on UBIFS_FS
	default y
	help
	   LZO compressor is generally faster than zlib but compresses worse.
	   Say 'N' if unsure.

config UBIFS_FS_ZLIB
	bool "ZLIB compression support" if UBIFS_FS_ADVANCED_COMPR
	depends on UBIFS_FS
	default y
	help
	  Zlib compresses better than LZO but it is slower. Say 'N' if unsure.

config UBIFS_ATIME_SUPPORT
	bool "Access time support" if UBIFS_FS
	depends on UBIFS_FS
	default n
	help
	  This option allows ubifs to support atime. -o strictatime is harmful to
	  your flash, we don't suggest it. But relatime and lazytime are much
	  better.

	  If unsure, say 'N'

config UBIFS_QUOTA_SUPPORT
	bool "Disk Quota support" if UBIFS_FS
	depends on UBIFS_FS
	default n
	help
	  This option allows ubifs to support disk quota. We reuse the quota
	  provided by VFS.

	  If unsure, say 'N'
```
